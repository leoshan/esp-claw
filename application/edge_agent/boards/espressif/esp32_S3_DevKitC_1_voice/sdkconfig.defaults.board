## components/claw_capabilities/cap_ble_trigger/Kconfig
```kconfig
menu "BLE Trigger Capability Configuration"

config CLAW_CAP_BLE_TRIGGER_ENABLED
    bool "Enable BLE Trigger Capability"
    default n
    depends on CLAW_CAP_VOICE_PIPELINE_ENABLED
    help
        Wireless push-to-talk: a remote BLE press starts voice capture and the
        matching release stops it, exactly as the on-board button does.

        Two sources feed the same trigger, and both can run at once:

          * A GATT service this device advertises. Any BLE debugging app can
            connect and write the trigger byte, which makes a phone usable as
            the button and is the only way to exercise this without hardware.

          * A BLE HID button (HOGP, service 0x1812) this device connects out
            to, for a real physical remote.

        Requires NimBLE with the central and observer roles enabled. This
        capability owns the NimBLE stack, so it cannot run alongside the `ble`
        or `ble_hid` Lua modules, which each own the stack themselves.

if CLAW_CAP_BLE_TRIGGER_ENABLED

config CLAW_CAP_BLE_TRIGGER_DEVICE_NAME
    string "Advertised device name"
    default "esp-claw-mic"
    help
        Name shown in the scan list of the phone app that connects to write
        the trigger byte.

config CLAW_CAP_BLE_TRIGGER_ADVERTISE
    bool "Advertise the trigger GATT service"
    default y
    help
        Turn off once a physical HID button is in use and no phone needs to
        connect, to stop advertising and free the connection slot.

config CLAW_CAP_BLE_TRIGGER_HID_HOST
    bool "Connect to BLE HID buttons"
    default y
    help
        Scan for peripherals advertising the HID service (0x1812) and treat
        their input reports as button presses.

config CLAW_CAP_BLE_TRIGGER_HID_SCAN_SEC
    int "HID scan window (seconds)"
    default 8
    range 2 30
    depends on CLAW_CAP_BLE_TRIGGER_HID_HOST
    help
        How long one scan runs. Scanning competes with Wi-Fi for the radio, so
        this never runs on a timer: it happens at startup and whenever
        ble_trigger_scan is called.

config CLAW_CAP_BLE_TRIGGER_HOLD_TIMEOUT_MS
    int "Maximum hold time (milliseconds)"
    default 15000
    range 1000 60000
    help
        A press with no matching release stops capture anyway after this long.
        Without it a dropped link mid-press would leave the microphone open
        until the recording cap expires.

endif

endmenu
```

## components/claw_capabilities/cap_phone_screen/Kconfig
```kconfig
menu "Phone screen (AirPlay receiver)"
    depends on APP_CLAW_CAP_PHONE_SCREEN

    config CAP_PHONE_SCREEN_RECEIVER_NAME
        string "AirPlay receiver name"
        default "ESP-Claw"
        help
            Name shown in the phone's Control Center -> Screen Mirroring list.

    config CAP_PHONE_SCREEN_RELAY_HOST
        string "Relay host (LAN IP of the machine running phone_relay/relay.py)"
        default ""

    config CAP_PHONE_SCREEN_RELAY_STREAM_PORT
        int "Relay H.264 stream port (TCP)"
        default 8091

    config CAP_PHONE_SCREEN_RELAY_HTTP_PORT
        int "Relay HTTP port (GET /frame.jpg)"
        default 8090

    config CAP_PHONE_SCREEN_WIDTH
        int "Advertised display width (the phone may ignore it)"
        default 480

    config CAP_PHONE_SCREEN_HEIGHT
        int "Advertised display height (the phone may ignore it)"
        default 1040

    config CAP_PHONE_SCREEN_MAX_FPS
        int "Advertised max fps"
        default 5
        range 1 60
endmenu
```

## components/claw_capabilities/cap_voice_pipeline/Kconfig
```kconfig
menu "Voice Pipeline Capability Configuration"

config CLAW_CAP_VOICE_PIPELINE_ENABLED
    bool "Enable Voice Pipeline Capability"
    default n
    help
        Streaming speech-to-text and text-to-speech through the Volcengine
        (Doubao) voice services.

        Audio pins are NOT configured here. The capability binds to the
        board's `i2s_audio_in` (microphone) and `i2s_audio_out` (speaker)
        peripherals declared in board_peripherals.yaml, so it only works on
        boards that declare both, and it can never conflict with pins the
        board assigns to other peripherals.

if CLAW_CAP_VOICE_PIPELINE_ENABLED

config CLAW_CAP_VOICE_SPEAKER_SAMPLE_RATE
    int "Speaker playback sample rate (Hz)"
    default 24000
    help
        Must match the sample_rate_hz of the board's i2s_audio_out peripheral.
        The TTS service is asked to synthesize at exactly this rate so the
        firmware never has to resample.

config CLAW_CAP_VOICE_RECORD_DURATION_SEC
    int "Maximum capture duration per utterance (seconds)"
    default 8
    range 1 30
    help
        Upper bound on how long one voice_listen call keeps streaming audio to
        the recognizer before it forces the final packet. Audio is streamed as
        it is captured, so this does not size any buffer.

endif

endmenu
```
